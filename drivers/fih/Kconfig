## drivers/fih/Kconfig
```kconfig
#
# FIH drivers configuration file
#

config FIH_SDM630_SDM660_PROJS
	bool "01 FIH_8937_PROJS"
	help
	Enable the support for FIH_8937_PROJS flag

config FIH_MFD
	bool "fih mfd"
	default y
	help
	  support fih mfd virtual file

config FIH_APR
	bool "fih apr"
	default y
	help
	  support fih apr virtual file

config FIH_SENSOR
	bool "fih sensor"
	default y
	help
	  support fih sensor virtual file

config FIH_TOUCH
        bool "fih touch"
        default y
        help
          support fih touch virtual file

config FIH_LCM
	bool "fih lcm"
	default y
	help
	  support fih lcm function

config FIH_HWCONFIG
	bool "fih hwcfg/swid/hwid"
	default y
	help
	  support fih hwcfg/swid/hwid function

config FIH_HALL_SENSOR
	bool "FIH Hall sensor"
	default y
```

## drivers/input/fingerprint/Kconfig
```kconfig
#
# Fingerprint driver configuration
#

menuconfig INPUT_FINGERPRINT
	bool "Fingerprints"
	help
	  Say Y here, and a list of supported fingerprints will be displayed.
	  This option doesn't affect the kernel.
	  If unsure, say Y.

if INPUT_FINGERPRINT

config FINGERPRINT_FPC1020
	bool "FPC 1020 Driver"
	default n
	help
	  This is a FPC 1020 chipset Driver.

source "drivers/input/fingerprint/elan/Kconfig"

endif
```

## drivers/nfc/SecNfc/Kconfig
```kconfig
#
# Near Field Communication (NFC) devices
#

config NFC_SEC
	bool "Samsung NFC driver"
	default y
	help
	  SAMSUNG NFC Driver.
	  This driver provides support for SAMSUNG NFC products.
	  You should select your NFC product and interface.

	  Say Y here to compile support for SAMSUNG NFC driver into the
	  kernel.
```

## drivers/video/Kconfig
```kconfig
#
# Video configuration
#

menu "Graphics support"
	depends on HAS_IOMEM

config HAVE_FB_ATMEL
	bool

config SH_MIPI_DSI
	tristate
	depends on (SUPERH || ARCH_SHMOBILE) && HAVE_CLK

config SH_LCD_MIPI_DSI
	bool

config BOOST_NT50356
        tristate "Boost and WLED Driver for BOOST_NT50356"
        depends on I2C
        select REGMAP_I2C
        help
          This supports NOVATEK BOOST_NT50356 Boost Converter and WLED driver

source "drivers/char/agp/Kconfig"

source "drivers/gpu/vga/Kconfig"

source "drivers/gpu/host1x/Kconfig"
source "drivers/gpu/ipu-v3/Kconfig"
source "drivers/gpu/msm/Kconfig"

source "drivers/gpu/drm/Kconfig"

source "drivers/video/msm/ba/Kconfig"
menu "Frame buffer Devices"
source "drivers/video/fbdev/Kconfig"
endmenu

source "drivers/video/backlight/Kconfig"
source "drivers/video/adf/Kconfig"

config VGASTATE
       tristate
       default n

config VIDEOMODE_HELPERS
	bool

config HDMI
	bool

if VT
	source "drivers/video/console/Kconfig"
endif

if FB || SGI_NEWPORT_CONSOLE
	source "drivers/video/logo/Kconfig"

endif


endmenu
```
